do ..\..\..\os\debug\lauterbach\S32V234.cmm
do ..\..\..\os\debug\lauterbach\S32V234-CA53.cmm
data.load.elf apex_face_detection_cv.elf

d.list
go main