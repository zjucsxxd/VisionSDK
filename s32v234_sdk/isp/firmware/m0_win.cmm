// T32_1000027 Mon Sep 21 15:14:41 2015

 B::
 
 TOOLBAR ON
 STATUSBAR ON
 FramePOS 263.71 0.0 212. 76.
 WinPAGE.RESet
 
 WinPAGE.Create P000
 WinCLEAR
 
 WinPOS 149.14 0.0 48. 12. 0. 0. W002
 r.view /spotlight
 
 WinPOS 149.0 46.167 81. 25. 5. 0. W001
 v.frame
 
 WinPOS 0.0 0.0 145. 71. 16. 1. W000
 WinTABS 10. 10. 25. 62.
 d.l
 
 WinPOS 148.86 15.417 88. 25. 8. 1. W003
 WinTABS 32.
 Trace.List
 
 WinPAGE.select P000
 
 ENDDO
