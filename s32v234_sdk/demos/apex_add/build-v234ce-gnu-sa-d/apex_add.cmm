do ..\..\..\os\debug\lauterbach\S32V234.cmm
do ..\..\..\os\debug\lauterbach\S32V234-CA53.cmm
data.load.elf apex_add.elf

d.list
y.spath add Y:\projects\vsdk\s32v234_sdk\demos\apex_add\src\

go main
