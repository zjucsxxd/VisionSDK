// T32_1000023 Wed Jun 10 12:00:29 2015

 B::
 
 TOOLBAR ON
 STATUSBAR ON
 FramePOS 3.1429,1.8333,,,Maximized
 WinPAGE.RESet
 
 WinPAGE.Create P000
 WinCLEAR
 
 WinPOS 161.0 34.167 63. 22. 5. 0. W003
 v.frame
 
 WinPOS 160.86 0.0 63. 30. 0. 0. W004
 r.view /spotlight
 
 WinPOS 0.0 0.0 157. 57. 24. 1. W002
 WinTABS 10. 10. 25. 62.
 d.l
 
 WinPAGE.select P000
 
 ENDDO
